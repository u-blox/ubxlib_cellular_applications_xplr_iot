## prj.conf
```kconfig
# Copyright 2022 u-blox
#
# Licensed under the Apache License, Version 2.0 (the "License");
# you may not use this file except in compliance with the License.
# You may obtain a copy of the License at
#
#  http://www.apache.org/licenses/LICENSE-2.0
#
# Unless required by applicable law or agreed to in writing, software
# distributed under the License is distributed on an "AS IS" BASIS,
# WITHOUT WARRANTIES OR CONDITIONS OF ANY KIND, either express or implied.

# Need to enable stack free functions
CONFIG_INIT_STACKS=y
CONFIG_THREAD_STACK_INFO=y
CONFIG_THREAD_NAME=y
CONFIG_SPI=y

# There are two theads per app task (task+queue).
# So here we need to make sure there are enough threads.
# (Check below for debug defines too...)
CONFIG_COMPILER_OPT="-DU_CFG_OS_MAX_THREADS=30"


#* ----------------------------------------------------------------
#* UBXLIB MUTEX DEBUGGING   Uncomment this line to enable the 
#*                          ubxlib mutex debugging, which will 
#*                          print out mutex information if a mutex
#*                          lock isn't given for a period of time
#*                          NOTE: Must also enable ubxlib debug
#*                          logging too. See above.
#*                          NOTE: Must re-compile ubxlib too as
#*                          this #define will enable that code.
#* ----------------------------------------------------------------
#CONFIG_COMPILER_OPT="-DU_CFG_OS_MAX_THREADS=30 -DU_CFG_MUTEX_DEBUG"


#* ----------------------------------------------------------------
#* Enable Heap Monitoring - This will display how many mallocs are 
#*                          left unfreed at the closing of the 
#*                          application. 
#*                          (This costs memory)
#* 
#*                          Comment out to remove heap monitoring
#* ----------------------------------------------------------------
#CONFIG_COMPILER_OPT="-DU_CFG_OS_MAX_THREADS=30 -DU_CFG_HEAP_MONITOR"
```

## src/main.c
```c
/*
 * Copyright 2022 u-blox
 *
 * Licensed under the Apache License, Version 2.0 (the "License");
 * you may not use this file except in compliance with the License.
 * You may obtain a copy of the License at
 *
 * http://www.apache.org/licenses/LICENSE-2.0
 *
 * Unless required by applicable law or agreed to in writing, software
 * distributed under the License is distributed on an "AS IS" BASIS,
 * WITHOUT WARRANTIES OR CONDITIONS OF ANY KIND, either express or implied.
 * See the License for the specific language governing permissions and
 * limitations under the License.
 */

/*
 *
 * Cellular tracking application based on the XPLR-IoT-1 device
 * Connects to an MQTT broker and publishes:
 *      o cellular rsrp/rsrq measurements
 *      o cellular CellID
 *      o GNSS Location
 *
 */

#include "common.h"

#include "appInit.h"
#include "taskControl.h"

#include "mqttTask.h"
#include "signalQualityTask.h"
#include "locationTask.h"
#include "cellScanTask.h"

#include "u_mutex_debug.h"

// Application name and version number is in the config.h file

/* ----------------------------------------------------------------
 * Remote control callbacks for the main application
 * Add your application topic message callbacks here
 * -------------------------------------------------------------- */
#define APP_CONTROL_TOPIC "AppControl"
static callbackCommand_t callbacks[] = {
    {"SET_DWELL_TIME", setAppDwellTime},
    {"SET_LOG_LEVEL", setAppLogLevel}
};

/// @brief The application function(s) which are run every appDwellTime
/// @return A flag to indicate the application should continue (true)
bool appFunction(void)
{
    queueMeasureNow(NULL);
    queueLocationNow(NULL); 

    return true;
}

void buttonTwo(void)
{
    queueNetworkScan(NULL);
}

bool networkIsUp(void)
{
    return gIsNetworkUp;
}

bool mqttConnectionIsUp(void)
{
    return gIsMQTTConnected;
}
/* ----------------------------------------------------------------
 * Main startup function for the framework
 * -------------------------------------------------------------- */
void main(void)
{
    if (!startupFramework())
        return;

    // The Network registration task is used to connect to the cellular network
    // This will monitor the +CxREG URCs
    if (runTask(NETWORK_REG_TASK, networkIsUp) != U_ERROR_COMMON_SUCCESS) goto FINALIZE;

    // The MQTT task connects and reconnects to the MQTT broker selected in the 
    // config.h file. This needs to run for MQTT messages to be published and
    // for remote control messages to be handled
    if (runTask(MQTT_TASK, mqttConnectionIsUp) != U_ERROR_COMMON_SUCCESS) goto FINALIZE;

    // Subscribe to the main AppControl topic for remote control the main application (this)
    subscribeToTopicAsync(APP_CONTROL_TOPIC, U_MQTT_QOS_AT_MOST_ONCE, callbacks, NUM_ELEMENTS(callbacks));

    // Set button two to point to the queueCellScan function
    setButtonTwoFunction(buttonTwo);

    // Start the application loop with our app function
    runApplicationLoop(appFunction);

FINALIZE:
    // all done, close down and finalize
    finalize(SHUTDOWN);
}
```

## src/exampleConfigFile.h
```c
/*
 * Copyright 2022 u-blox
 *
 * Licensed under the Apache License, Version 2.0 (the "License");
 * you may not use this file except in compliance with the License.
 * You may obtain a copy of the License at
 *
 * http://www.apache.org/licenses/LICENSE-2.0
 *
 * Unless required by applicable law or agreed to in writing, software
 * distributed under the License is distributed on an "AS IS" BASIS,
 * WITHOUT WARRANTIES OR CONDITIONS OF ANY KIND, either express or implied.
 * See the License for the specific language governing permissions and
 * limitations under the License.
 */

/*
 *
 * Configuration File - for saving to the ConfigFile.txt file
 *
 * THIS MUST NOT BE CHECKED IN TO SOURCE CONTROL!!!
 *
 */

#ifndef _CONFIG_FILE_H_
#define _CONFIG_FILE_H_

// Simple way to create a text file which is saved to the file system
#define CONFIG_FILE_CONTENTS "MQTT_BROKER_NAME:xxx.xxx.xxx.xxx\n" \
                             "MQTT_BROKER_PORT:xxxx" \
                             "MQTT_USERNAME:username\n" \
                             "MQTT_PASSWORD:password\n" \
                             "MQTT-TYPE:MQTT\n"

#endif
```

## src/mqtt_credentials.c
```c
/*
 * Copyright 2022 u-blox
 *
 * Licensed under the Apache License, Version 2.0 (the "License");
 * you may not use this file except in compliance with the License.
 * You may obtain a copy of the License at
 *
 * http://www.apache.org/licenses/LICENSE-2.0
 *
 * Unless required by applicable law or agreed to in writing, software
 * distributed under the License is distributed on an "AS IS" BASIS,
 * WITHOUT WARRANTIES OR CONDITIONS OF ANY KIND, either express or implied.
 * See the License for the specific language governing permissions and
 * limitations under the License.
 */

/*
 * MQTT Credentials examples
 * Select which one to use in the config.h file.
 *
 * Use a single space to separate the paramater name to the value.
 *
 * MQTT-TYPE is either "MQTT" or "MQTT-SN"
 * You can use NULL for unused parameters, like no username or password
 *
 * If you set MQTT_CLIENTID to NULL in this configuration UBXLIB will automatically set
 * the IMEI of the cellular device being used. So unless you MUST set the clientID for
 * your own MQTT broker, you can leave this parameter NULL.
 *
 * For MQTT brokers that don't use security, set MQTT_SECURITY to FALSE (or NULL)
 * For MQTT brokers that require security, set the MQTT_SECURITY to TRUE.
 * Use the SECURITY_XXXX Parameters to configure the security profile
 * 
 * NOTE: You will need to have already uploaded certificates to the SARA-R5 module
 *       To do this you will need to use the XPLR-IoT-1-Software firmware so that
 *       you can directly talk to the SARA-R5 module with m-center and upload the 
 *       certificates.
 *
 * Missing entries will resolve to NULL if they are used in the application.
 *
 * Experiment with KeepAlive (TRUE/FALSE) and Timeout Values (seconds)
*/

#include "common.h"
#include "../config/config.h"

// This is the configuration for loading the MQTT configuration that is already on saved on the file system
#ifdef MQTT_FILE_SYSTEM
const char *mqttCredentials[] = {};       // NULL will cause the application to only load from file system
#endif

// This is the Thingstream MQTT-Anywhere configuration.
// !!! You MUST use "TSUDP" for the APN !!!
//
// There is no need for username & password or clientID
// Thingstream MQTT-Anywhere uses the SIM security from the network operator
#ifdef MQTT_THINGSTREAM_ANYWHERE
const char *mqttCredentials[] = {
    "MQTT_TYPE MQTT-SN",
    "MQTT_BROKER_NAME 10.7.0.55:2442",
    "MQTT_USERNAME NULL",
    "MQTT_PASSWORD NULL",
    "MQTT_CLIENTID NULL",
    "MQTT_KEEPALIVE NULL",
    "MQTT_TIMEOUT NULL",
    "MQTT_SECURITY FALSE",
    
    // no need to set or include these as there is no security
    "SECURITY_CERT_VALID_LEVEL 0",
    "SECURITY_TLS_VERSION 3",
    "SECURITY_CIPHER_SUITE 0",
    "SECURITY_CLIENT_NAME NULL",
    "SECURITY_CLIENT_KEY NULL",
    "SECURITY_SERVER_NAME_IND NULL",
};
#endif

// This is the Thingstream MQTT-FLEX service configuration.
// Port 2443 uses TLS security with client certificate and key
#ifdef MQTT_THINGSTREAM_FLEX
const char *mqttCredentials[] = {
    "MQTT_TYPE MQTT-SN",
    "MQTT_BROKER_NAME mqtt-flex.thingstream.io:2443",
    "MQTT_USERNAME NULL",
    "MQTT_PASSWORD NULL",
    "MQTT_CLIENTID device:5378b7ce-7e8a-4fec-afc4-58eae6ca32b0",
    "MQTT_KEEPALIVE NULL",
    "MQTT_TIMEOUT NULL",
    "MQTT_SECURITY TRUE",
    
    // Set TLS security and specify the security
    // manager client certificate name and key 
    "SECURITY_CERT_VALID_LEVEL 0",
    "SECURITY_TLS_VERSION 3",
    "SECURITY_CIPHER_SUITE 0",
    "SECURITY_CLIENT_NAME device-5378b7ce.pem",
    "SECURITY_CLIENT_KEY device-5378b7ce.key",
    "SECURITY_SERVER_NAME_IND mqtt-flex.thingstream.io",
};
#endif

// This is the Thingstream MQTT-NOW service configuration.
// Port 1883 doesn't use TLS security, just authentication
// Must provide username and password below...
#ifdef MQTT_THINGSTREAM_NOW_NoTLS_Auth
const char *mqttCredentials[] = {
    "MQTT_TYPE MQTT",
    "MQTT_BROKER_NAME mqtt.thingstream.io:1883",
    "MQTT_USERNAME YOUR-USER-NAME-HERE",
    "MQTT_PASSWORD YOUR-PASSWORD-HERE",
    "MQTT_CLIENTID NULL",
    "MQTT_KEEPALIVE NULL",
    "MQTT_TIMEOUT NULL",    
    "MQTT_SECURITY FALSE",
    
    // no need to set or include these as there is no security
    "SECURITY_CERT_VALID_LEVEL 0",
    "SECURITY_TLS_VERSION 3",
    "SECURITY_CIPHER_SUITE 0",
    "SECURITY_CLIENT_NAME NULL",
    "SECURITY_CLIENT_KEY NULL",
    "SECURITY_SERVER_NAME_IND NULL",
};
#endif

// This is the MQTT-NOW service configuration.
// Port 8883 uses TLS security and authentication
// Must provide username and password below...
#ifdef MQTT_THINGSTREAM_NOW_TLS_Auth
const char *mqttCredentials[] = {
    "MQTT_TYPE MQTT",
    "MQTT_BROKER_NAME mqtt.thingstream.io:8883",
    "MQTT_USERNAME YOUR-USER-NAME-HERE",
    "MQTT_PASSWORD YOUR-PASSWORD-HERE",
    "MQTT_CLIENTID NULL",
    "MQTT_KEEPALIVE NULL",
    "MQTT_TIMEOUT NULL",
    "MQTT_SECURITY TRUE",
    
    // Just set TLS security
    "SECURITY_CERT_VALID_LEVEL 0",
    "SECURITY_TLS_VERSION 3",
    "SECURITY_CIPHER_SUITE 0",
    "SECURITY_CLIENT_NAME NULL",
    "SECURITY_CLIENT_KEY NULL",
    "SECURITY_SERVER_NAME_IND NULL",
};
#endif

// This is the mosquitto test server configuration.
// Port 1883 has no security or authentication
#ifdef MQTT_MOSQUITTO_NoTLS_NoAuth
const char *mqttCredentials[] = {
    "MQTT_TYPE MQTT",
    "MQTT_BROKER_NAME test.mosquitto.org:1883",
    "MQTT_USERNAME NULL",
    "MQTT_PASSWORD NULL",
    "MQTT_CLIENTID NULL",
    "MQTT_KEEPALIVE NULL",
    "MQTT_TIMEOUT NULL",
    "MQTT_SECURITY FALSE",
    
    // no need to set or include these as there is no security
    "SECURITY_CERT_VALID_LEVEL 0",
    "SECURITY_TLS_VERSION 3",
    "SECURITY_CIPHER_SUITE 0",
    "SECURITY_CLIENT_NAME NULL",
    "SECURITY_CLIENT_KEY NULL",
    "SECURITY_SERVER_NAME_IND NULL",
};
#endif

// This is the mosquitto test server configuration.
// Port 1884 uses username/password authentication only
// "rw" and "readwrite" for the username/password
#ifdef MQTT_MOSQUITTO_NoTLS_Auth
const char *mqttCredentials[] = {
    "MQTT_TYPE MQTT",
    "MQTT_BROKER_NAME test.mosquitto.org:1884",
    "MQTT_USERNAME rw",
    "MQTT_PASSWORD readwrite",
    "MQTT_CLIENTID NULL",
    "MQTT_KEEPALIVE NULL",
    "MQTT_TIMEOUT NULL",
    "MQTT_SECURITY FALSE",
    
    // no need to set or include these as there is no security
    "SECURITY_CERT_VALID_LEVEL 0",
    "SECURITY_TLS_VERSION 3",
    "SECURITY_CIPHER_SUITE 0",
    "SECURITY_CLIENT_NAME NULL",
    "SECURITY_CLIENT_KEY NULL",
    "SECURITY_SERVER_NAME_IND NULL",
};
#endif

// This is the mosquitto test server configuration.
// Port 8884 uses client certificate for authentication
#ifdef MQTT_MOSQUITTO_TLS_Cert
const char *mqttCredentials[] = {
    "MQTT_TYPE MQTT",
    "MQTT_BROKER_NAME test.mosquitto.org:8884",
    "MQTT_USERNAME NULL",
    "MQTT_PASSWORD NULL",
    "MQTT_CLIENTID NULL",
    "MQTT_KEEPALIVE NULL",
    "MQTT_TIMEOUT NULL",
    "MQTT_SECURITY TRUE",
    
    // no need to set or include these as there is no security
    "SECURITY_CERT_VALID_LEVEL 0",
    "SECURITY_TLS_VERSION 3",
    "SECURITY_CIPHER_SUITE 0",
    "SECURITY_CLIENT_NAME YOUR_CLIENT_CERTIFICATE_NAME_HERE",
    "SECURITY_CLIENT_KEY YOUR_CLIENT_PRIVATE_KEY_HERE",
    "SECURITY_SERVER_NAME_IND NULL",
};
#endif

// This is the mosquitto test server configuration.
// Port 8885 uses TLS security and username/password authentication
#ifdef MQTT_MOSQUITTO_TLS_Auth
const char *mqttCredentials[] = {
    "MQTT_TYPE MQTT",
    "MQTT_BROKER_NAME test.mosquitto.org:8885",
    "MQTT_USERNAME rw",
    "MQTT_PASSWORD readwrite",
    "MQTT_CLIENTID NULL",
    "MQTT_KEEPALIVE NULL",
    "MQTT_TIMEOUT NULL",
    "MQTT_SECURITY TRUE",
    
    // Just enable TLS
    "SECURITY_CERT_VALID_LEVEL 0",
    "SECURITY_TLS_VERSION 3",
    "SECURITY_CIPHER_SUITE 0",
    "SECURITY_CLIENT_NAME NULL",
    "SECURITY_CLIENT_KEY NULL",
    "SECURITY_SERVER_NAME_IND NULL",
};
#endif

const int32_t mqttCredentialsSize = NUM_ELEMENTS(mqttCredentials);
```
